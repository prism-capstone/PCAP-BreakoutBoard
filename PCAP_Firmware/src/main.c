/**
 * @file main.c
 * @brief Main application for PCAP04 capacitive sensor system (ESP-IDF)
 *
 * This firmware reads capacitive sensor data from multiple PCAP04 chips,
 * applies neural network-based hysteresis compensation, and transmits
 * the data via BLE to connected mobile applications.
 */

#include <math.h>
#include <stdio.h>
#include <string.h>
#include "freertos/FreeRTOS.h"
#include "freertos/task.h"

#include "esp_log.h"
#include "esp_system.h"
#include "esp_chip_info.h"
#include "esp_flash.h"
#include "esp_task_wdt.h"

#include "pcap_driver.h"
#include "battery_manager.h"
#include "nn_inference.h"
#include "ble_manager.h"

// Add battery header if available
// #include "battery.h"  // Uncomment when battery.h exists

static const char* TAG = "MAIN";

// Set to 1 to enable human-readable debug output via printf instead of
// the machine-readable CSV serial format used by the normal data path.
#define DEBUG_MODE 1

// Storage for sensor data from all chips
static pcap_data_t chip_data[NUM_PCAP_CHIPS];

// Battery monitoring configuration
#define BATTERY_UPDATE_INTERVAL_MS 5000  // Update every 5 seconds

// External battery function declaration
extern uint8_t battery_get_percentage(void);

// Standard configuration (from original firmware)
static const uint8_t standard_config[PCAP_CONFIG_SIZE] = {
    0x03, 0x11, 0xF8, 0x10, 0x90, 0x0C, 0x3F, 0x0A, 0x00, 0xF4, 0x01, 0x00, 0x27, 0x00, 0x0A, 0x00,
    0x13, 0x78, 0x00, 0x01, 0x00, 0x01, 0x50, 0x30, 0x73, 0x04, 0x50, 0x00, 0x5A, 0x00, 0x82, 0x08,
    0x08, 0x00, 0x47, 0x40, 0x00, 0x00, 0x00, 0x71, 0x00, 0x00, 0x08, 0x00, 0x00, 0x00, 0x00, 0x01,
    0x00, 0x00, 0x00, 0x00
};

// Standard firmware (from original firmware)
static const uint8_t standard_firmware[PCAP_FW_SIZE] = {
    0x24, 0x05, 0xA0, 0x01, 0x20, 0x55, 0x42, 0x5C, 0x48, 0xB1, 0x07, 0x92, 0x02, 0x20, 0x13, 0x02,
    0x20, 0x93, 0x02, 0xB2, 0x02, 0x78, 0x20, 0x54, 0xB3, 0x06, 0x91, 0x00, 0x7F, 0x20, 0x86, 0x20,
    0x54, 0xB6, 0x03, 0x72, 0x62, 0x20, 0x54, 0xB7, 0x00, 0x00, 0x42, 0x5C, 0xA1, 0x00, 0x49, 0xB0,
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    0xAE, 0xED, 0x44, 0x02, 0x00, 0x00, 0x00, 0x00, 0x00, 0x00, 0x00, 0x00, 0x00, 0x00, 0x00, 0x00,
    // Padding to 1024 bytes
    0x00, 0x00, 0x00, 0x00, 0x00, 0x00, 0x00, 0x00, 0x00, 0x00, 0x00, 0x00, 0x00, 0x00, 0x00, 0x00,
    0x00, 0x00, 0x00, 0x00, 0x00, 0x00, 0x00, 0x00, 0x00, 0x00, 0x00, 0x00, 0x00, 0x00, 0x00, 0x00,
    0x00, 0x00, 0x00, 0x00, 0x00, 0x00, 0x00, 0x00, 0x00, 0x00, 0x00, 0x00, 0x00, 0x00, 0x00, 0x00,
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    0x00, 0x00, 0x00, 0x00, 0x00, 0x00, 0x00, 0x00, 0x00, 0x00, 0x00, 0x00, 0x00, 0x00, 0x00, 0x00
};

// Function declarations
static void print_diagnostics(void);
static void sensor_task(void *pvParameters);
static void battery_task(void *pvParameters);

static void print_diagnostics(void)
{
    esp_chip_info_t chip_info;
    uint32_t flash_size;

    esp_chip_info(&chip_info);

    ESP_LOGI(TAG, "========================================");
    ESP_LOGI(TAG, "--- System Diagnostics ---");
    ESP_LOGI(TAG, "Chip: %s with %d CPU core(s)",
             CONFIG_IDF_TARGET, chip_info.cores);
    ESP_LOGI(TAG, "Silicon revision: %d", chip_info.revision);

    if (esp_flash_get_size(NULL, &flash_size) == ESP_OK) {
        ESP_LOGI(TAG, "Flash size: %lu MB", flash_size / (1024 * 1024));
    }

    ESP_LOGI(TAG, "Free heap: %lu bytes", esp_get_free_heap_size());
    ESP_LOGI(TAG, "Minimum free heap: %lu bytes", esp_get_minimum_free_heap_size());

    ESP_LOGI(TAG, "--- Pin Configuration ---");
    ESP_LOGI(TAG, "MUX_S0_PIN: GPIO %d", MUX_S0_PIN);
    ESP_LOGI(TAG, "MUX_S1_PIN: GPIO %d", MUX_S1_PIN);
    ESP_LOGI(TAG, "MUX_S2_PIN: GPIO %d", MUX_S2_PIN);
    ESP_LOGI(TAG, "SPI MOSI: GPIO %d", PCAP_SPI_MOSI_PIN);
    ESP_LOGI(TAG, "SPI MISO: GPIO %d", PCAP_SPI_MISO_PIN);
    ESP_LOGI(TAG, "SPI SCLK: GPIO %d", PCAP_SPI_SCLK_PIN);

    ESP_LOGI(TAG, "--- Configuration ---");
    ESP_LOGI(TAG, "Number of PCAP chips: %d", NUM_PCAP_CHIPS);
    ESP_LOGI(TAG, "Sensors per chip: %d", NUM_SENSORS_PER_CHIP);
    ESP_LOGI(TAG, "NN inference ready: %s", nn_is_ready() ? "YES" : "NO");
    ESP_LOGI(TAG, "========================================");
}

/**
 * @brief Send chip sensor data to serial in place of BLE (Serial mode).
 *
 * Format: "D,<chip>,<s0>,<s1>,<s2>,<s3>,<s4>,<s5>\n"
 * Mirrors the same 20Hz cadence as the BLE send path.
 */
static void serial_send_chip_data(uint8_t chip_num, pcap_data_t* data)
{
    printf("D,%d", chip_num);
    for (int i = 0; i < NUM_SENSORS_PER_CHIP; i++) {
        if(!nn_is_ready()) {
            data->final_val[i] = (PCAP_SCALING_NUM * (float)(data->raw[i] - data->offset[i])/PCAP_CONVERSION_NUMBER);
        }

        float val = data->final_val[i];
        printf(",%.4f", val);
    }
    printf("\n");
}

/**
 * @brief Send battery percentage to serial in place of BLE (Serial mode).
 *
 * Format: "B,<percentage>\n"
 */
static void serial_send_battery(uint8_t battery_pct)
{
    printf("B,%d\n", battery_pct);
}

static void print_results(void)
{
    static int print_counter = 0;
    float value = 0;

    // Only print every 50 measurements (every 500ms at 100Hz)
    print_counter++;
    if (print_counter < 50) {
        return;
    }
    print_counter = 0;

    // Print header
    printf("\n--- PCAP Measurements (100Hz sampling) ---\n");
    printf("Chip | S0       | S1       | S2       | S3       | S4       | S5\n");
    printf("-----|----------|----------|----------|----------|----------|----------\n");

    // Print data for each chip
    for (int chip = FIRST_PCAP_ID; chip < NUM_PCAP_CHIPS; chip++) {
        printf("  %d  | ", chip + 1);

        for (int sensor = 0; sensor < NUM_SENSORS_PER_CHIP; sensor++) {
            // Use NN-compensated value if available, otherwise raw-offset
            if (!nn_is_ready()) {
                chip_data[chip].final_val[sensor] = (PCAP_SCALING_NUM * (float)(chip_data[chip].raw[sensor] - chip_data[chip].offset[sensor])/PCAP_CONVERSION_NUMBER);            
            }

            value = chip_data[chip].final_val[sensor];
            printf("%.2f | ", value);
        }
        printf("\n");
    }

    // Print NN stats if available
    if (nn_is_ready()) {
        printf("NN inference time: %lu us (avg)\n", nn_get_inference_time_us());
    }
}

/**
 * @brief Battery monitoring task
 *
 * Periodically reads battery level and sends it over BLE or Serial.
 * Runs independently from sensor task to avoid coupling.
 */
static void battery_task(void *pvParameters)
{
    ESP_LOGI(TAG, "Battery monitoring task started");
    
    TickType_t last_update = 0;
    const TickType_t update_period = pdMS_TO_TICKS(BATTERY_UPDATE_INTERVAL_MS);
    
    // Wait a bit for system to initialize
    vTaskDelay(pdMS_TO_TICKS(2000));
    
    while (1) {
        TickType_t current_time = xTaskGetTickCount();
        
        // Update battery level periodically
        if ((current_time - last_update) >= update_period) {
            last_update = current_time;
            
            // Read battery percentage
            uint8_t battery_pct = battery_get_percentage();

            if (ble_is_connected()) {
                ble_send_battery(battery_pct);
            } else {
#if DEBUG_MODE
                printf("Battery: %d%%\n", battery_pct);
#else
                serial_send_battery(battery_pct);
#endif
            }
        }
        
        // Sleep for most of the period to save CPU
        vTaskDelay(pdMS_TO_TICKS(2000));
    }
}

static void sensor_task(void *pvParameters)
{
    TickType_t last_measurement = 0;
    const TickType_t measurement_period = pdMS_TO_TICKS(10);   // 100Hz

    ESP_LOGI(TAG, "Sensor task started");

    while (1) {
        TickType_t current_time = xTaskGetTickCount();

        // Take measurement every 10ms (100Hz)
        if ((current_time - last_measurement) >= measurement_period) {
            last_measurement = current_time;

            // Read results from each chip
            for (int pcap_num = FIRST_PCAP_ID; pcap_num < NUM_PCAP_CHIPS; pcap_num++) {
                pcap_read_data((pcap_chip_select_t)pcap_num, &chip_data[pcap_num]);

                // Apply NN-based hysteresis compensation
                if (nn_is_ready()) {
                    nn_compensate_chip(&chip_data[pcap_num], pcap_num);
                }
            }

            if (ble_is_connected()) {
                for (int pcap_num = FIRST_PCAP_ID; pcap_num < NUM_PCAP_CHIPS; pcap_num++) {
                    ble_send_chip_data(pcap_num, &chip_data[pcap_num]);
                }
            } else {
#if DEBUG_MODE
                print_results();
#else
                for (int pcap_num = FIRST_PCAP_ID; pcap_num < NUM_PCAP_CHIPS; pcap_num++) {
                    serial_send_chip_data(pcap_num, &chip_data[pcap_num]);
                }
#endif
            }
        }

        // Delay to allow other tasks to run
        vTaskDelay(pdMS_TO_TICKS(10));
    }
}

void app_main(void)
{
    ESP_LOGI(TAG, "========================================");
    ESP_LOGI(TAG, "PCAP04 ESP32C3 Firmware Starting...");
    ESP_LOGI(TAG, "========================================");

    bool test_result = false;

    // Initialize PCAP driver (includes SPI and MUX init)
    pcap_driver_init();
    vTaskDelay(pdMS_TO_TICKS(1000));

    // Test communication with each chip
    ESP_LOGI(TAG, "--- Testing Communication ---");
    for (int pcap_num = FIRST_PCAP_ID; pcap_num < NUM_PCAP_CHIPS; pcap_num++) {
        // Block until we validate a successful communication
        test_result = false;
        while (!test_result) {
            test_result = pcap_test_communication((pcap_chip_select_t)pcap_num);
            vTaskDelay(pdMS_TO_TICKS(10));
        }
    }

    // Initialize chips
    ESP_LOGI(TAG, "--- Initializing Chips ---");
    for (int pcap_num = FIRST_PCAP_ID; pcap_num < NUM_PCAP_CHIPS; pcap_num++) {
        pcap_init_chip((pcap_chip_select_t)pcap_num);
        pcap_write_firmware((pcap_chip_select_t)pcap_num, standard_firmware, PCAP_FW_SIZE);
        pcap_write_config((pcap_chip_select_t)pcap_num, standard_config, PCAP_CONFIG_SIZE);
        pcap_start_cdc((pcap_chip_select_t)pcap_num);
    }

    // Wait for first measurement to complete
    ESP_LOGI(TAG, "--- Waiting for measurements to stabilize ---");
    vTaskDelay(pdMS_TO_TICKS(20));

    // Calibrate all chips
    ESP_LOGI(TAG, "--- Calibrating Sensors ---");
    for (int pcap_num = FIRST_PCAP_ID; pcap_num < NUM_PCAP_CHIPS; pcap_num++) {
        pcap_calibrate((pcap_chip_select_t)pcap_num, &chip_data[pcap_num], 10);
    }

    // Initialize battery ADC
    ESP_LOGI(TAG, "--- Initializing Battery ADC ---");
    battery_adc_init();

    // Initialize BLE
    ESP_LOGI(TAG, "--- Initializing BLE ---");
    ble_manager_init();

    // Initialize Neural Network (optional - will gracefully fail if no model)
    ESP_LOGI(TAG, "--- Initializing Neural Network ---");

    // if (nn_init()) {
    //     ESP_LOGI(TAG, "Neural network initialized successfully");
    // } else {
    //     ESP_LOGW(TAG, "Neural network initialization failed - using raw values");
    // }

    // Print diagnostics 
    print_diagnostics();

    ESP_LOGI(TAG, "Setup complete! Starting measurements...");

    // Create sensor task (high priority for time-critical measurements)
    xTaskCreate(sensor_task, "sensor_task", 4096, NULL, 5, NULL);
    
    // Create battery monitoring task (lower priority, less time-critical)
    xTaskCreate(battery_task, "battery_task", 4096, NULL, 3, NULL);

    // Main task can now idle
    while (1) {
        vTaskDelay(pdMS_TO_TICKS(1000));
    }
}