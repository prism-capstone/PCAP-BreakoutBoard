## PCAP_Firmware/sdkconfig.defaults
```kconfig
# ESP-IDF SDK Configuration defaults for PCAP Firmware

# Target configuration
CONFIG_IDF_TARGET="esp32c3"

# Partition table
CONFIG_PARTITION_TABLE_CUSTOM=y
CONFIG_PARTITION_TABLE_CUSTOM_FILENAME="partitions.csv"

# Bluetooth configuration - use NimBLE (more memory efficient)
CONFIG_BT_ENABLED=y
CONFIG_BT_NIMBLE_ENABLED=y
CONFIG_BT_NIMBLE_MAX_CONNECTIONS=1
CONFIG_BT_NIMBLE_MAX_BONDS=3
CONFIG_BT_NIMBLE_ROLE_PERIPHERAL=y
CONFIG_BT_NIMBLE_ROLE_CENTRAL=n
CONFIG_BT_NIMBLE_ROLE_OBSERVER=n
CONFIG_BT_NIMBLE_ROLE_BROADCASTER=y

# Disable Classic Bluetooth to save memory
CONFIG_BT_CLASSIC_ENABLED=n

# Optimize memory for TFLite
CONFIG_ESP_MAIN_TASK_STACK_SIZE=8192
CONFIG_FREERTOS_WATCHPOINT_END_OF_STACK=y

# SPI configuration
CONFIG_SPI_MASTER_IN_IRAM=y

# Logging
CONFIG_LOG_DEFAULT_LEVEL_INFO=y

# Compiler optimization for performance
CONFIG_COMPILER_OPTIMIZATION_PERF=y

# C++ exceptions disabled to save memory (TFLite doesn't need them)
CONFIG_COMPILER_CXX_EXCEPTIONS=n

# Flash configuration
CONFIG_ESPTOOLPY_FLASHSIZE_4MB=y
CONFIG_ESPTOOLPY_FLASHMODE_QIO=y

# CPU frequency
CONFIG_ESP_DEFAULT_CPU_FREQ_MHZ_160=y
```
